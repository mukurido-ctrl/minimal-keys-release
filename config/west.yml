## config/west.yml
```yaml
manifest:
  remotes:
    - name: zmkfirmware
      url-base: https://github.com/zmkfirmware
    - name: hyhy-masa
      url-base: https://github.com/hyhy-masa
    - name: caksoylar
      url-base: https://github.com/caksoylar
  projects:
    - name: zmk
      remote: zmkfirmware
      revision: v0.3.0
      import: app/west.yml
    - name: zmk-pmw3610-driver
      remote: hyhy-masa
      revision: main
    - name: zmk-rgbled-widget
      remote: caksoylar
      revision: main
    # 完全に独立した定義として記述
    - name: urob_config_module
      url: https://github.com/urob/zmk-node-free-config.git
      revision: main
  self:
    path: config
```
